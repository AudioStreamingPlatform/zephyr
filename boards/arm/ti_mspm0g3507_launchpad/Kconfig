## boards/arm/ti_mspm0g3507_launchpad/Kconfig.board
```kconfig
# TI LaunchPad MSPM0G3507 Development Board

# SPDX-License-Identifier: Apache-2.0

config BOARD_TI_MSPM0G3507_LAUNCHPAD
	bool "TI MSPM0G3507 LauncPad Kit"
	depends on SOC_MSPM0G3507
```

## boards/arm/ti_mspm0g3507_launchpad/Kconfig.defconfig
```kconfig
# TI LaunchPad MSPM0G3507 Development Board

# SPDX-License-Identifier: Apache-2.0

config BOARD
	default "ti_mspm0g3507_launchpad"
	depends on BOARD_TI_MSPM0G3507_LAUNCHPAD
```

## boards/arm/ti_mspm0g3507_launchpad/ti_mspm0g3507_launchpad_defconfig
```kconfig
# SPDX-License-Identifier: Apache-2.0

CONFIG_BOARD_TI_MSPM0G3507_LAUNCHPAD=y
CONFIG_SOC_SERIES_MSPM0G350X=y
CONFIG_SOC_MSPM0G3507=y

CONFIG_ARM_MPU=y

CONFIG_GPIO=y
CONFIG_PINCTRL=y

# enable uart driver
CONFIG_SERIAL=y

# enable console
CONFIG_CONSOLE=y
CONFIG_UART_CONSOLE=y

# Enable internal ADCs
CONFIG_ADC=y

# Required for flashing
CONFIG_BUILD_OUTPUT_HEX=y
```

## drivers/adc/Kconfig.mspm0
```kconfig
# SPDX-License-Identifier: Apache-2.0

config ADC_MSPM0
	bool "MSPM0 ADC driver"
	default y
	depends on DT_HAS_TI_MSPM0_ADC_ENABLED
	help
	  This option enables the MSPM0 ADC driver.
```

## drivers/counter/Kconfig.mspm0
```kconfig
config COUNTER_MSPM0
    bool "Driver to interface with MSPM0 hardware clocks"
    default n
    depends on DT_HAS_TI_MSPM0_COUNTER_ENABLED
        help
            Enables support for TIMERG{0, 6, 7, 12}
```

## drivers/gpio/Kconfig.mspm0
```kconfig
# MSPM0 GPIO configuration options

# SPDX-License-Identifier: Apache-2.0

config GPIO_MSPM0
	bool "TI MSPM0 GPIO driver"
	default y
	depends on DT_HAS_TI_MSPM0_GPIO_ENABLED
	help
	  Enable the GPIO driver for TI MSPM0 series
```

## drivers/lin/Kconfig
```kconfig
# LIN driver configuration options

# SPDX-License-Identifier: Apache-2.0

menuconfig LIN
    bool "LIN Drivers"
    help
      Enable LIN Driver Configuration

if LIN

module = LIN
module-str = lin
source "subsys/logging/Kconfig.template.log_config"

config LIN_SHELL
	bool "LIN Shell"
	depends on SHELL
	help
	  Enable LIN Shell.

	  The LIN shell supports reading and writing (update me)

config LIN_INIT_PRIORITY
  int "LIN driver init priority"
  default KERNEL_INIT_PRIORITY_DEVICE
  help
    LIN driver device initialization priority.

source "drivers/lin/Kconfig.mspm0"

source "drivers/lin/Kconfig.uart"

endif # LIN
```

## drivers/lin/Kconfig.mspm0
```kconfig
# SPDX-License-Identifier: Apache-2.0
# Copyright (c) 2024 Texas Instruments

config LIN_MSPM0
	bool "MSPM0 LIN protocol over UART driver"
	default y
	depends on DT_HAS_TI_MSPM0_LIN_ENABLED
	select LIN_HAS_DRIVER
	select LIN_SUPPORT_INTERRUPT
	help
  This option enables the TI MSPM0 LIN UART driver.
```

## drivers/pinctrl/Kconfig.mspm0
```kconfig
# SPDX-License-Identifier: Apache-2.0

config PINCTRL_MSPM0
	bool "TI MSPM0 PINCTRL driver"
	default y
	depends on DT_HAS_TI_MSPM0G350X_PINCTRL_ENABLED
	help
	  Enable the GPIO driver for TI MSPM0 series
```

## drivers/pwm/Kconfig.mspm0
```kconfig
# Copyright (C) 2024 Bang & Olufsen A/S, Denmark
#
# SPDX-License-Identifier: Apache-2.0

config PWM_MSPM0
	bool "Driver to interface with MSPM0 hardware pwm"
        default n
        depends on DT_HAS_TI_MSPM0_PWM_ENABLED
        help
          Enables support for PWM driver for TIMx Modules for mspm0gxxx family of chips
```

## drivers/serial/Kconfig.mspm0
```kconfig
# SPDX-License-Identifier: Apache-2.0

config UART_MSPM0
	bool "MSPM0 UART driver"
	default y
	depends on DT_HAS_TI_MSPM0_UART_ENABLED
	select SERIAL_HAS_DRIVER
	select SERIAL_SUPPORT_INTERRUPT
	help
	  This option enables the MSPM0 UART driver
```

## dts/bindings/adc/ti,adc-mspm0.yaml
```yaml
# SPDX-License-Identifier: Apache-2.0

description: mspm0 ADC node

compatible: "ti,mspm0-adc"

include: adc-controller.yaml

properties:
  reg:
    required: true

  interrupts:
    required: true

  "#io-channel-cells":
    const: 1

io-channel-cells:
  - input
```

## dts/bindings/gpio/ti,mspm0-gpio.yaml
```yaml
# SPDX-License-Identifier: Apache-2.0
description: TI MSPM0 GPIO node

compatible: "ti,mspm0-gpio"

include: [gpio-controller.yaml, base.yaml]

properties:
  reg:
    required: true

  interrupts:
    required: false

  "#gpio-cells":
    const: 2

gpio-cells:
  - pin
  - flags
```

## dts/bindings/i2c/ti,mspm0g3xxx-i2c.yaml
```yaml
# SPDX-License-Identifier: Apache-2.0

description: TI MSPM0G3XXX I2C

compatible: "ti,mspm0g3xxx-i2c"

include: [i2c-controller.yaml, pinctrl-device.yaml, base.yaml]

properties:
  reg:
    required: true

  target-mode-only:
    type: boolean
    description: |
      Will skip setup of i2c-controller mode when no target is registered.
      This can be useful for when only target mode is wanted.

  interrupts:
    required: true

  pinctrl-0:
    required: true

  pinctrl-names:
    required: true
```

## dts/bindings/lin/ti,mspm0-lin.yaml
```yaml
# Copyright (C) 2024 Bang & Olufsen A/S, Denmark
#
# SPDX-License-Identifier: Apache-2.0

description: TI MSPM0 LIN uart driver

compatible: "ti,mspm0-lin"

include: lin-controller.yaml
```

## dts/bindings/pinctrl/ti,mspm0g350x-pinctrl.yaml
```yaml
# SPDX-License-Identifier: Apache-2.0
#
description: MSPM0G350X pin control

include: base.yaml

compatible: "ti,mspm0g350x-pinctrl"

child-binding:
  child-binding:
    include:
      - name: pincfg-node.yaml
        property-allowlist:
          - bias-disable
          - bias-pull-down
          - bias-pull-up

    properties:
      pinmux:
        required: true
        type: array
        description: |
          UPDATE ME
```

## dts/bindings/pwm/ti,mspm0-pwm.yaml
```yaml
# Copyright (C) 2024 Bang & Olufsen A/S, Denmark
#
# SPDX-License-Identifier: Apache-2.0

description: |
  Driver to enable MSPM0 PWM hardware for TIMx timers (TIMA/TIMG).
  This driver is implementing the existing Zephyr PWM API (pwm_driver_api) and
  supports the set_cycles and get_cycles_per_sec functions.
  Note, supported capture channel direction for now is up to Capture Channel 2 or 4
  (depending on the timer used) and output only.

compatible: "ti,mspm0-pwm"

include: [base.yaml, pinctrl-device.yaml, pwm-controller.yaml]

properties:
  ti,prescaler:
    required: true
    type: int
    default: 0
    description: Specifies the value used to divide the input clock frequency, allowing adjustment of the effective clock rate used by the timer.

  ti,mode:
    required: true
    type: int
    description: Determines the operating mode of the timer.
    enum:
      - 0
      - 16
      - 32
    description: |
      The supported PWM modes are the following:
        - 0: "Configure the pwm timer as Edge Align"
        - 16: "Configure the pwm timer as Center Align"
        - 32: "Configure the pwm timer as Edge Align Up"

  ti,clock-frequency:
    const: 32000000
    type: int
    required: true
    description: Defines the clock frequency that the module will use. This value is required and should be treated as read-only; it must not be modified after initial configuration.

  ti,divide-ratio:
    type: int
    required: true
    description: Sets the division ratio for the clock, which controls how the clock frequency is divided before use.

  "#pwm-cells":
    const: 3

pwm-cells:
  - channel
  - period
  - flags
```

## soc/arm/ti_mspm0/Kconfig
```kconfig
# Texas Instruments MSPM0 Family

# SPDX-License-Identifier: Apache-2.0

config SOC_FAMILY_TIMSPM0
	bool

if SOC_FAMILY_TIMSPM0

config SOC_FAMILY
	string
	default "ti_mspm0"

source "soc/arm/ti_mspm0/*/Kconfig.soc"

endif # SOC_FAMILY_TIMSPM0
```

## soc/arm/ti_mspm0/mspm0g1xxx/Kconfig.defconfig.mspm0g1106
```kconfig
# TI MSPM0G1106 SoC

# SPDX-License-Identifier: Apache-2.0

if SOC_MSPM0G1106

config SOC
	default "mspm0g1106"

config SYS_CLOCK_HW_CYCLES_PER_SEC
	default 32000000

config NUM_IRQS
	default 32

endif # SOC_MSPM0G1106
```

## soc/arm/ti_mspm0/mspm0g1xxx/Kconfig.defconfig.series
```kconfig
# TI MSPM0G1XXX

# SPDX-License-Identifier: Apache-2.0

if SOC_SERIES_MSPM0G1XXX

source "soc/arm/ti_mspm0/mspm0g1xxx/Kconfig.defconfig.mspm0g1*"

config SOC_SERIES
	default "mspm0g1xxx"

endif # SOC_SERIES_MSPM0G1XXX
```

## soc/arm/ti_mspm0/mspm0g1xxx/Kconfig.series
```kconfig
# TI MSPM0G1XXX

# SPDX-License-Identifier: Apache-2.0

config SOC_SERIES_MSPM0G1XXX
	bool "TI MSPM0 Family MSPM0G1XXX"
	select ARM
	select CPU_CORTEX_M0PLUS
	select CPU_CORTEX_M_HAS_VTOR
	select CPU_HAS_ARM_MPU
	select SOC_FAMILY_TIMSPM0
	select CPU_CORTEX_M_HAS_SYSTICK
	help
	  Enable support for TI MSPM0G1XXX.
```

## soc/arm/ti_mspm0/mspm0g1xxx/Kconfig.soc
```kconfig
# Texas Instruments MSPM0G1XXX

# SPDX-License-Identifier: Apache-2.0

choice
	prompt "TI MSPM0 MCU Selection"
	depends on SOC_SERIES_MSPM0G1XXX

	config SOC_MSPM0G1106
		bool "MSPM0G1106"
endchoice
```

## soc/arm/ti_mspm0/mspm0g350x/Kconfig.defconfig.mspm0g3507
```kconfig
# TI MSPM0G3507 SoC

# SPDX-License-Identifier: Apache-2.0

if SOC_MSPM0G3507

config SOC
	default "mspm0g3507"

config SYS_CLOCK_HW_CYCLES_PER_SEC
	default 32000000

config SYS_CLOCK_TICKS_PER_SEC
    default 32768

config NUM_IRQS
	default 44

endif # SOC_MSPM0G3507
```

## soc/arm/ti_mspm0/mspm0g350x/Kconfig.defconfig.series
```kconfig
# TI MSPMG350x

# SPDX-License-Identifier: Apache-2.0

if SOC_SERIES_MSPM0G350X

source "soc/arm/ti_mspm0/mspm0g350x/Kconfig.defconfig.mspm0g3507"

config SOC_SERIES
	default "mspm0g350x"

endif # SOC_SERIES_MSPM0G350X
```
