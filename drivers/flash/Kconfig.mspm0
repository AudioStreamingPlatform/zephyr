## drivers/flash/Kconfig.mspm0
```kconfig
config FLASHCTL_MSPM0
	bool "TI FLASH MSPM0 driver"
	default n
	select USE_MSPM0_DL_FLASHCTL
```

## drivers/i2c/Kconfig.mspm0
```kconfig
# SPDX-License-Identifier: Apache-2.0

config I2C_MSPM0
	bool "TI I2C MSPM0 driver"
	default y
	depends on DT_HAS_TI_MSPM0_I2C_ENABLED
	help
	  Enable support for I2C on the TI MSPM0 series.

if I2C_MSPM0

config I2C_MSPM0_TARGET_SUPPORT
	bool "TI I2C_MSPM0 target support"
	default n
	help
	  Enable support for i2c-target functionality
	  for TI MSPM0 driver.

config I2C_MSPM0_TRANSFER_TIMEOUT
	int "Transfer timeout [ms]"
	default 100
	help
	  Timeout in milliseconds used for each I2C transfer.
	  0 means that the driver should use the K_FOREVER value,
	  i.e. it should wait as long as necessary.

config I2C_MSPM0_WATCHDOG
	bool "TI I2C MSPM0 watchdog support"
	help
	  Enable support for a watchdog plugin that NACKs the I2C message
	  and panics the device if the processing of a byte takes too long.

if I2C_MSPM0_WATCHDOG

config I2C_MSPM0_WATCHDOG_TIMEOUT
    int "I2C watchdog reset timeout (us)"
    default 300
    help
      Defines the timeout in microseconds after which the watchdog will
      reset the I2C lines and trigger a system panic.

config I2C_MSPM0_WATCHDOG_PANIC_CODE
    int "I2C watchdog reset panic code"
    default 17
    help
      Defines the panic code that will be triggered when the I2C watchdog
      times out and resets the I2C lines. This code can be used for debugging
      or logging the failure reason.


config I2C_MSPM0_INIT_PRIORITY
    int "TI I2C MSPM0 init priority"
    default COUNTER_INIT_PRIORITY
    help
      Define the driver init priority. The driver has a dependency on the counter
      component.

endif # I2C_MSPM0_WATCHDOG

endif # I2C_MSPM0
```

## drivers/i2c/Kconfig.mspm0g3xxx
```kconfig
# SPDX-License-Identifier: Apache-2.0

config I2C_MSPM0G3XXX
	bool "TI I2C MSPM0G3XXX driver"
	default y
	depends on DT_HAS_TI_MSPM0G3XXX_I2C_ENABLED
	help
	  Enable support for I2C on the TI MSPM0G3XXX series.

if I2C_MSPM0G3XXX

config I2C_MSPM0G3XXX_TARGET_SUPPORT
	bool "TI I2C_MSPM0G3XXX target support"
	default n
	help
	  Enable support for i2c-target functionality
	  for TI MSPM0G3XXX driver.

config I2C_MSPM0G3XXX_TRANSFER_TIMEOUT
	int "Transfer timeout [ms]"
	default 100
	help
	  Timeout in milliseconds used for each I2C transfer.
	  0 means that the driver should use the K_FOREVER value,
	  i.e. it should wait as long as necessary.

config I2C_MSPM0G3XXX_WATCHDOG_TIMEOUT
    int "I2C watchdog reset timeout (us)"
    default 300
    help
      Defines the timeout in microseconds after which the watchdog will
      reset the I2C lines and trigger a system panic.

config I2C_MSPM0G3XXX_WATCHDOG_PANIC_CODE
    int "I2C watchdog reset panic code"
    default 17
    help
      Defines the panic code that will be triggered when the I2C watchdog
      times out and resets the I2C lines. This code can be used for debugging
      or logging the failure reason.


config I2C_MSPM0G3XXX_INIT_PRIORITY
    int "TI I2C MSPM0G3XXX init priority"
    default COUNTER_INIT_PRIORITY
    help
      Define the driver init priority. The driver has a dependency on the counter
      component.

endif # I2C_MSPM0G3XXX
```

## dts/bindings/adc/ti,mspm0-adc12.yaml
```yaml
description: TI MSPM0 ADC12

compatible: "ti,mspm0-adc12"

include: [adc-controller.yaml, pinctrl-device.yaml]

properties:
  reg:
    required: true

  interrupts:
    required: true

  clocks:
    required: true

  pinctrl-0:
    required: true

  pinctrl-names:
    required: true

  "#io-channel-cells":
    const: 1

  ti,clk-range:
    type: int
    required: true
    description: |
      ADC clock range.
      Must be selected accordingly to the selected clocks.
      Check available options in dt_bindings/adc/mspm0_adc.h

  ti,clk-div:
    type: int
    required: true
    description: Sample clock divider, applies to the selected clocks.

  vref-mv:
    type: int
    default: 2500
    description: Voltage reference in mV

io-channel-cells:
  - input
```

## dts/bindings/counter/ti,mspm0-counter.yaml
```yaml
# Copyright (C) 2024 Bang & Olufsen A/S, Denmark
#
# SPDX-License-Identifier: LicenseRef-BnOProprietary

description: Driver to enable MSPM0 Hardware Timers. Currently it only supports TIMG{0, 6, 7, 12}.

include: [base.yaml]

compatible: "ti,mspm0-counter"

properties:
  mode:
    type: int
    required: true

  reg:
    required: true

  interrupts:
    required: true

  resolution:
    type: int
    required: true

  clocks:
    required: true

  ti,prescaler:
    required: true
    type: int
    default: 0
    description: Specifies the value used to divide the input clock frequency,
      allowing adjustment of the effective clock rate used by the timer.

  ti,divider:
    type: int
    required: true
    description: Sets the division ratio for the clock, which controls how the
      clock frequency is divided before use.
```

## dts/bindings/i2c/ti,mspm0-i2c.yaml
```yaml
# SPDX-License-Identifier: Apache-2.0

description: TI MSPM0 I2C

compatible: "ti,mspm0-i2c"

include: [i2c-controller.yaml, pinctrl-device.yaml, base.yaml]

properties:
  reg:
    required: true

  scl-gpios:
    type: phandle-array
    description: |
      GPIO the SCL line is muxed to. Optional, but required for bus recovery:
      i2c_recover_bus() re-muxes SCL and SDA to GPIO, clocks the bus until a
      target that was left mid-byte releases SDA, issues a STOP and restores
      the pinctrl state. Without these the recover_bus callback reports
      -ENOTSUP and a target holding SDA low wedges the bus permanently.

  sda-gpios:
    type: phandle-array
    description: |
      GPIO the SDA line is muxed to. See scl-gpios.

  msg-timeout-ms:
    type: int
    description: |
      Timeout for a single struct i2c_msg, not for a whole i2c_transfer(), so
      a two-message transfer can take twice this value. 0 waits forever.
      Defaults to CONFIG_I2C_MSPM0_TRANSFER_TIMEOUT.

      Must exceed the longest SCL stretch any target on this bus performs, or
      the controller abandons a valid message mid-byte and leaves the target
      driving SDA low, wedging the bus.

      When a host drives this controller as an i2c-proxy, it arms one timeout
      for an operation that this driver runs as one i2c_transfer() of up to
      two messages, each preceded by a bounded idle wait, with a bus-idle poll
      after a read. The host timeout must therefore satisfy:

        T_host > 3 * msg-timeout-ms + 2 * B
        B     = MIN(msg-timeout-ms, 100 ms)

      Raising this without raising T_host to match makes that race worse.

  target-mode-only:
    type: boolean
    description: |
      Will skip setup of i2c-controller mode when no target is registered.
      This can be useful for when only target mode is wanted.

  interrupts:
    required: true

  pinctrl-0:
    required: true

  pinctrl-names:
    required: true

  watchdog-timer:
    type: phandle
    description: |
      The type of the phandle object should be a counter device.
      When the system is crashing, the I2C lines (SDA/SCL) are not being
      reset and might stay LOW. To address this issue, we need to ensure that
      none of the user i2c driver callbacks (that are doing reads or writes)
      are taking longer than CONFIG_I2C_MSPM0_WATCHDOG_TIMEOUT. So we
      fire a timer before each call. If the callback doesn't finish fast
      enough, the watchdog callback will reset the i2c lines, NACK the i2c
      message and panic with the CONFIG_MSPM0_I2C_WATCHDOG_PANIC_CODE
      error code.

  clocks:
    required: true

  ti,clk-div:
    type: int
    required: true
    default: 1
    enum:
      - 1
      - 2
      - 3
      - 4
      - 5
      - 6
      - 7
      - 8
    description: Sets the division ratio for the clock, which controls how the
      clock frequency is divided before use.
```

## dts/bindings/led/led-controller.yaml
```yaml
# Copyright (c) 2020 Seagate Technology LLC
# SPDX-License-Identifier: Apache-2.0

# Common fields for LED controllers and child LEDs

properties:
  led-max-microamp:
    type: int
    description: |
      Maximum current that can be delivered to the led by defaul.
      Meant to limit the amount a current a led can take, so tweaking
      delivered current will not go over this value. Beware that, if
      wrongly set, it will enable the possibility of hardware damage
      led side. Such setting can be overriden per-led (see led-node).

child-binding:
  description: LED child node

  include: led-node.yaml

  properties:
    index:
      type: int
      description: |
        Index of the LED on a controller. It can be used by drivers or
        applications to map a logical LED to its real position on the
        controller. For example, this allows to handle boards where the
        LEDs in an array/strip are not wired following the LED order of
        the controller.
```

## dts/bindings/led/led-node.yaml
```yaml
# Copyright (c) 2025 Seagate Technology LLC
# SPDX-License-Identifier: Apache-2.0

# Common fields for LED nodes

properties:
  label:
    type: string
    description: |
      Human readable string describing the LED. It can be used by an
      application to identify this LED or to retrieve its number/index
      (i.e. child node number) on the parent device.
  color-mapping:
    type: array
    description: |
      Channel to color mapping of a multicolor LED. If a LED supports
      several colors, then the color-mapping property can be used to
      describe how the hardware channels and the colors are mapped.

      For example the channel to color mapping of RGB LEDs would be

         color-mapping =
              <LED_COLOR_ID_RED>,
              <LED_COLOR_ID_GREEN>,
              <LED_COLOR_ID_BLUE>;
  led-max-microamp:
    type: int
    description: |
      Maximum current that can be delivered to the led. Meant to limit
      the amount a current a led can take, so tweaking delivered current
      will not go over this value. Beware that, if wrongly set, it will
      enable the possibility of hardware damage led side.
```

## dts/bindings/serial/ti,mspm0-uart.yaml
```yaml
description: TI MSPM0 UART

compatible: "ti,mspm0-uart"

include: [uart-controller.yaml, pinctrl-device.yaml, base.yaml]

properties:
  reg:
    required: true

  interrupts:
    required: true

  pinctrl-0:
    required: true

  pinctrl-names:
    required: true

  clk-div:
    type: int
    default: 1
    enum:
      - 1
      - 2
      - 3
      - 4
      - 5
      - 6
      - 7
      - 8
    description: |
      Clock divider selection value.

  rx-fifo-threshold:
    type: string
    default: "1_2_full"
    enum:
      - "one_entry"
      - "1_4_full"
      - "1_2_full"
      - "3_4_full"
      - "full"
    description: |
      RX FIFO interrupt threshold level. Interrupt fires when the FIFO
      reaches this level. Defaults to `1_2_full` (half full). Use `one_entry` for
      protocols that require per-byte interrupt delivery.

  tx-fifo-threshold:
    type: string
    default: "empty"
    enum:
      - "one_entry"
      - "1_4_empty"
      - "1_2_empty"
      - "3_4_empty"
      - "empty"
    description: |
      TX FIFO interrupt threshold level. Interrupt fires when the FIFO
      reaches this level. Defaults to `empty`.
```

## dts/bindings/spi/ti,mspm0-spi.yaml
```yaml
description: TI MSPM0 SPI

compatible: "ti,mspm0-spi"

include: [spi-controller.yaml, pinctrl-device.yaml, base.yaml]

properties:
  reg:
    required: true

  interrupts:
    required: true

  pinctrl-0:
    required: true

  pinctrl-names:
    required: true

  clocks:
    required: true

  ti,clk-div:
    type: int
    required: true
    description: Sets the division ratio for the clock, which controls how the
      clock frequency is divided before use.
```

## tests/subsys/debug/coredump_in_memory/testcase.yaml
```yaml
tests:
  debug.coredump.in_memory:
    tags: coredump
    timeout: 30
    ignore_faults: true
    ignore_qemu_crash: true
    filter: CONFIG_ARCH_SUPPORTS_COREDUMP
#    platform_allow:
    arch_exclude:
      - posix
    integration_platforms:
      - qemu_cortex_m0
    harness: console
    harness_config:
      type: multi_line
      regex:
        - "IN-MEMORY COREDUMP FOUND [0-9]+"
```
