## soc/arm/ti_mspm0/mspm0g350x/Kconfig.series
```kconfig
# TI MSPM0G350X

# SPDX-License-Identifier: Apache-2.0

config SOC_SERIES_MSPM0G350X
	bool "TI Family MSPM0G350X"
	select ARM
	select CPU_CORTEX_M0PLUS
	select CPU_HAS_ARM_MPU
	select CPU_CORTEX_M_HAS_SYSTICK
	select CPU_CORTEX_M_HAS_VTOR
	select SOC_FAMILY_TIMSPM0
	help
	  Enable support for TI MSPM0G350X series.
```

## soc/arm/ti_mspm0/mspm0g350x/Kconfig.soc
```kconfig
# Texas Instruments MSPM0G350X

# SPDX-License-Identifier: Apache-2.0

choice
	prompt "TI MSPM0 MCU Selection"
	depends on SOC_SERIES_MSPM0G350X

config SOC_MSPM0G3507
	bool "MSPM0G3507"
	select HAS_MSPM0G350XSDK
endchoice
```
